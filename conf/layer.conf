## conf/layer.conf
```bitbake
# We have a conf and classes directory, add to BBPATH
BBPATH .= ":${LAYERDIR}"

# We have recipes-* directories, add to BBFILES
BBFILES += "${LAYERDIR}/recipes-*/*/*.bb \
            ${LAYERDIR}/recipes-*/*/*.bbappend"

BBFILE_COLLECTIONS += "meta-deepview"
BBFILE_PATTERN_meta-deepview = "^${LAYERDIR}/"
BBFILE_PRIORITY_meta-deepview = "10"

LAYERDEPENDS_meta-deepview = "core"
LAYERSERIES_COMPAT_meta-deepview = "dunfell kirkstone scarthgap"
```
